/*********************************Copyright (c)*********************************
**                               
**
**--------------File Info-------------------------------------------------------
** File Name:               hmc5883.c
** Last modified Date:      
** Last Version:            
** Description:             三维磁阻仪传感器
**
**------------------------------------------------------------------------------
** Created By:              wanxuncpx
** Created date:            
** Version:                 
** Descriptions:            
**
*******************************************************************************/

/******************************************************************************
更新说明:
    
******************************************************************************/

/******************************************************************************
*********************************  应 用 资 料 ********************************
******************************************************************************/

/******************************************************************************
********************************* 文件引用部分 ********************************
******************************************************************************/


/******************************************************************************
******************************* 自定义参数配置 ********************************
******************************************************************************/


/******************************************************************************
********************************* 数 据 声 明 *********************************
******************************************************************************/
/*---------------------* 
*    IMPORT:由外提供   * 
*----------------------*/
//none

/*---------------------* 
*    EXPORT:向外提供   * 
*----------------------*/
//none

/******************************************************************************
********************************* 函 数 声 明 *********************************
******************************************************************************/
/*---------------------* 
*    IMPORT:由外提供   * 
*----------------------*/
//none

/*---------------------* 
*    EXPORT:向外提供   * 
*----------------------*/
//none
#include <stdio.h>
#define HMC5883L_Addr       0x3C            //磁场传感器器件地址
#define HMC5883L_INT_PRIO   5

/******************************************************************************
***************************** HMC5883L 宏定义 *********************************
******************************************************************************/
/*---------------------* 
*  HMC5883L内部寄存器  * 
*----------------------*/
#define HMC5883L_REGA   0x00
#define HMC5883L_REGB   0x01
#define HMC5883L_MODE   0x02
#define HMC5883L_HX_H   0x03
#define HMC5883L_HX_L   0x04 
#define HMC5883L_HZ_H   0x05
#define HMC5883L_HZ_L   0x06
#define HMC5883L_HY_H   0x07
#define HMC5883L_HY_L   0x08
#define HMC5883L_STATE  0x09
#define HMC5883L_IRA    0x0a    //读序列号使用的寄存器
#define HMC5883L_IRB    0x0b
#define HMC5883L_IRC    0x0c 

/*---------------------* 
*   HMC5883 数据类型   * 
*----------------------*/
typedef  short int16_t;
typedef unsigned short uint16_t;
typedef unsigned char uint8_t;
typedef unsigned int uint32_t;
typedef int int32_t;
#define true 1
#define false 0


typedef struct
{
    int16_t  hx;
    int16_t  hy;
    int16_t  hz;
    uint16_t ha;   
}tg_HMC5883L_TYPE;

/*---------------------* 
*   HMC5883 校正参数   * 
*----------------------*/
// 漂移系数。单位：1单位地磁场强度
#define HMC5883L_OFFSET_X   (9)
#define HMC5883L_OFFSET_Y   (149)

//比例因子
#define HMC5883L_GAIN_X     1f
//#define HMC5883L_GAIN_Y   1.04034582
#define HMC5883L_GAIN_Y     10403     //实际1.04034582,这里便于整除 

/******************************************************************************
*********************************  程序开始  **********************************
******************************************************************************/
#include <math.h>




char i2cWrite(uint8_t addr, uint8_t reg, uint8_t data);



/******************************************************************************
/ 函数功能:初始化HMC5883
/ 修改日期:none
/ 输入参数:none
/ 输出参数:none
/ 使用说明:none
******************************************************************************/
void  HMC5883L_Init(void)
{
   Single_Write(HMC5883L_Addr,HMC5883L_REGA,0x14);   //30Hz
   Single_Write(HMC5883L_Addr,HMC5883L_MODE,0x00);   //连续测量模式
}

/******************************************************************************
/ 函数功能:读取HMC5883的数据
/ 修改日期:none
/ 输入参数:none
/ 输出参数:none
/ 使用说明:none
******************************************************************************/
void Delayms(uint32_t time)
{
   uint16_t i=0;  
   while(time--)
   {
      i=8000;
      while(i--);
   }  
}
void HMC5883L_Read(tg_HMC5883L_TYPE * ptResult)
{
    uint8_t tmp[6];
    int32_t s32Val;
    
    i2cWrite(HMC5883L_Addr,HMC5883L_REGA,0x14);   //30Hz
    i2cWrite(HMC5883L_Addr,HMC5883L_MODE,0x00);   //连续测量模式
    Delayms(10);
    
    tmp[0]=Single_Read(HMC5883L_Addr,HMC5883L_HX_H);//OUT_X_L_A
    tmp[1]=Single_Read(HMC5883L_Addr,HMC5883L_HX_L);//OUT_X_H_A
    
    tmp[2]=Single_Read(HMC5883L_Addr,HMC5883L_HZ_H);//OUT_Z_L_A
    tmp[3]=Single_Read(HMC5883L_Addr,HMC5883L_HZ_L);//OUT_Z_H_A
    
    tmp[4]=Single_Read(HMC5883L_Addr,HMC5883L_HY_H);//OUT_Y_L_A
    tmp[5]=Single_Read(HMC5883L_Addr,HMC5883L_HY_L);//OUT_Y_H_A

    ptResult->hx  = (int16_t)((tmp[0] << 8) | tmp[1])+HMC5883L_OFFSET_X;
    s32Val = (int16_t)((tmp[4] << 8) | tmp[5])+HMC5883L_OFFSET_Y;    
    s32Val = (s32Val*HMC5883L_GAIN_Y)/10000;
    ptResult->hy    = (int16_t)s32Val;
    ptResult->hz    = (int16_t)((tmp[2] << 8) | tmp[3]);
}

/******************************************************************************
/ 函数功能:启动HMC5883开始转换(适用于启动-中断-读取数据的程序)
/ 修改日期:none
/ 输入参数:none
/ 输出参数:none
/ 使用说明:启动-中断-查询 (启动)
******************************************************************************/
void HMC5883L_Start(void)
{
   Single_Write(HMC5883L_Addr,HMC5883L_REGA,0x14);   //30Hz
   Single_Write(HMC5883L_Addr,HMC5883L_MODE,0x00);   //连续测量模式
}

/******************************************************************************
/ 函数功能:读取HMC5883的数据(适用于启动-中断-读取数据的程序)
/ 修改日期:none
/ 输入参数:none
/ 输出参数:none
/ 使用说明:启动-中断-查询 (查询)
******************************************************************************/
void HMC5883L_MultRead(tg_HMC5883L_TYPE * ptResult)
{
    uint8_t tmp[6];
    int32_t s32Val;

    if(true == Mult_Read(HMC5883L_Addr,HMC5883L_HX_H,tmp,6))   //多读读出传感器数据
    {
        //修正数据(根据x轴修正y轴输出)
     //   ptResult->hx  = (int16_t)((tmp[0] << 8) | tmp[1])+HMC5883L_OFFSET_X;
     //   s32Val = (int16_t)((tmp[4] << 8) | tmp[5])+HMC5883L_OFFSET_Y;    
    //    s32Val = (s32Val*HMC5883L_GAIN_Y)/10000;
     //   ptResult->hy    = (int16_t)s32Val;
      ptResult->hx    = (int16_t)((tmp[0] << 8) | tmp[1]);
	 ptResult->hy   = (int16_t)((tmp[4] << 8) | tmp[5]);
        ptResult->hz    = (int16_t)((tmp[2] << 8) | tmp[3]);
    }
} 

/******************************************************************************
/ 函数功能:HMC5883校准
/ 修改日期:none
/ 输入参数:none
/ 输出参数:none
/ 使用说明:启动-中断-查询 (查询)
******************************************************************************/
void HMC5883L_Calibrate(void)
{
   i2cWrite(HMC5883L_Addr,HMC5883L_REGA,0x15);   //30Hz,启动自检模式
   i2cWrite(HMC5883L_Addr,HMC5883L_MODE,0x01);   //单一测量模式
   Delayms(10);
   i2cWrite(HMC5883L_Addr,HMC5883L_REGA,0x14);
   i2cWrite(HMC5883L_Addr,HMC5883L_MODE,0x00);   //回到工作模式
}

/******************************************************************************
/ 函数功能:打印HMC的传感器数据
/ 修改日期:none
/ 输入参数:none
/ 输出参数:none
/ 使用说明:none
******************************************************************************/
void HMC5883L_Printf(tg_HMC5883L_TYPE * ptResult)
{
    int16_t x,y;
    float angle;
    
    x = ptResult->hx;
    y = ptResult->hy;
    //求出方向
    if(x>0x7fff)x-=0xffff;
    if(y>0x7fff)y-=0xffff;
    //LED1_ON();
    angle= atan2(y,x) * (180 / 3.14159265) + 180;   //160us计算时间
    //LED1_OFF();
    ptResult->ha = (int16_t)(angle*10);   // 得到方向精确到0.1°
 //   printf("HMC5883L:\thx: %4d,\thy: %4d,\thz: %4d,\t%4d\n\r",
    //        ptResult->hx, ptResult->hy, ptResult->hz, ptResult->ha/10);
}




